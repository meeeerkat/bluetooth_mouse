## main/Kconfig.projbuild
```kconfig
menu "Inputs config"

    config LEFT_CLICK_TOUCH_IO
        int "Left click TOUCH IO number"
        range 0 9
        default 0

    config RIGHT_CLICK_TOUCH_IO
        int "Right click TOUCH IO number"
        range 0 9
        default 2

    config UP_KEY_TOUCH_IO
        int "Up key TOUCH IO number"
        range 0 9
        default 4

    config DOWN_KEY_TOUCH_IO
        int "Down key TOUCH IO number"
        range 0 9
        default 5

    config LEFT_KEY_TOUCH_IO
        int "Left key TOUCH IO number"
        range 0 9
        default 6

    config RIGHT_KEY_TOUCH_IO
        int "Right key TOUCH IO number"
        range 0 9
        default 7

    config INPUT_MOVE_DELTA_MIN
        int "Minimum cursor move at each refresh"
        range 0 10000
        default 10

    config INPUT_MOVE_DELTA_MAX
        int "Maximum cursor move at each refresh"
        range 0 10000
        default 100
    
    config INPUT_REFRESH_DELTA
        int "Time between each input processing & refresh"
        range 0 1000
        default 50

endmenu
```
